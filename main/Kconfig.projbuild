## main/Kconfig.projbuild
```kconfig
menu "WIFI Configuration"
    config ESP_WIFI_SSID
        string "WiFi SSID"
        default "myssid"
        help
            SSID (network name) for the example to connect to.

    config ESP_WIFI_PASSWORD
        string "WiFi Password"
        default "mypassword"
        help
            WiFi password (WPA or WPA2) for the example to use.

    choice ESP_WIFI_SAE_MODE
        prompt "WPA3 SAE mode selection"
        default ESP_WPA3_SAE_PWE_BOTH
        help
            Select mode for SAE as Hunt and Peck, H2E or both.
        config ESP_WPA3_SAE_PWE_HUNT_AND_PECK
            bool "HUNT AND PECK"
        config ESP_WPA3_SAE_PWE_HASH_TO_ELEMENT
            bool "H2E"
        config ESP_WPA3_SAE_PWE_BOTH
            bool "BOTH"
    endchoice

    config ESP_WIFI_PW_ID
        string "PASSWORD IDENTIFIER"
        depends on  ESP_WPA3_SAE_PWE_HASH_TO_ELEMENT|| ESP_WPA3_SAE_PWE_BOTH
        default ""
        help
            password identifier for SAE H2E

    config ESP_MAXIMUM_RETRY
        int "Maximum retry"
        default 5
        help
            Set the Maximum retry to avoid station reconnecting to the AP unlimited when the AP is really inexistent.

    choice ESP_WIFI_SCAN_AUTH_MODE_THRESHOLD
        prompt "WiFi Scan auth mode threshold"
        default ESP_WIFI_AUTH_WPA2_PSK
        help
            The weakest authmode to accept in the scan mode.
            This value defaults to ESP_WIFI_AUTH_WPA2_PSK incase password is present and ESP_WIFI_AUTH_OPEN is used.
            Please select ESP_WIFI_AUTH_WEP/ESP_WIFI_AUTH_WPA_PSK incase AP is operating in WEP/WPA mode.

        config ESP_WIFI_AUTH_OPEN
            bool "OPEN"
        config ESP_WIFI_AUTH_WEP
            bool "WEP"
        config ESP_WIFI_AUTH_WPA_PSK
            bool "WPA PSK"
        config ESP_WIFI_AUTH_WPA2_PSK
            bool "WPA2 PSK"
        config ESP_WIFI_AUTH_WPA_WPA2_PSK
            bool "WPA/WPA2 PSK"
        config ESP_WIFI_AUTH_WPA3_PSK
            bool "WPA3 PSK"
        config ESP_WIFI_AUTH_WPA2_WPA3_PSK
            bool "WPA2/WPA3 PSK"
        config ESP_WIFI_AUTH_WAPI_PSK
            bool "WAPI PSK"
    endchoice

endmenu

menu "MQTT Configuration"

    config MQTT_DEVICE_ID
        string "Set MQTT Device ID  [needs to be unique]"
        default "device1"
        help
            The device id for MQTT messages

    config BROKER_URL
        string "Broker URL"
        default "mqtt://192.168.1.10"
        help
            URL of the broker to connect to

    config BROKER_URL_FROM_STDIN
        bool
        default y if BROKER_URL = "FROM_STDIN"

    config MQTT_KEEPALIVE
        int "Set MQTT Keepalive time (s)"
        default 60
        help
            The keepalive time for MQTT messages


    config MQTT_TOPIC_MAIN
        string "Set the MQTT main topic [fixed value for all devices]"
        default "lightstrips"
        help
            The main topic for the MQTT messages


    config MQTT_TOPIC_STATE
            string "Set the MQTT brodcast state topic [fixed value for all devices]"
            default "sts"
            help
                The led state topic for the MQTT messages

    config MQTT_TOPIC_COMMAND
        string "Set the MQTT command topic [fixed value for all devices]"
        default "cmd"
        help
            The brodcast and idvidual device command topic for the MQTT messages
endmenu



menu "LED Strip/Ring Configuration"
    config LED_GPIO
        int "LED GPIO"
        default 22
        help
            Set the GPIO pin for the LED strip/ring.

    config LED_COUNT
        int "LED Count"
        default 12
        help
            Set the number of LEDs in the strip/ring.

    config LED_RMT_RES_HZ
        int "LED RMT Resolution (Hz)  10MHz resolution, 1 tick = 0.1us, default = (10 * 700 * 700)"
        default 4900000
        help
            10MHz resolution, 1 tick = 0.1us (led strip needs a high resolution) default = (10 * 700 * 700)

            
    choice LED_MODEL_TYPE_CHOICE
        prompt "LED Model Type"
        default LED_MODEL_WS2812
        help
            Set the LED model type.

        config LED_MODEL_WS2812
            bool "WS2812"
        config LED_MODEL_SK6812
            bool "SK6812"

    endchoice

endmenu
```
